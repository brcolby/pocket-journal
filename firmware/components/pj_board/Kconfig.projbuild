## firmware/components/pj_board/Kconfig.projbuild
```kconfig
menu "Pocket Journal OTA"

config PJ_OTA_TRUSTED_PUBLIC_KEY_HEX
    string "Trusted OTA ECDSA public key (DER SubjectPublicKeyInfo, hex)"
    default ""
    help
        Hex-encoded DER SubjectPublicKeyInfo for the ECDSA signing key trusted
        by partner-driven OTA. An empty or invalid value intentionally disables
        OTA activation: preflight fails closed with
        verification_key_unconfigured. OTA activation also requires ESP-IDF
        signed-app verification (SECURE_SIGNED_APPS_NO_SECURE_BOOT with update
        verification, or hardware Secure Boot); without it ota.write remains
        disabled even when this manifest key is configured.

config PJ_OTA_MAX_IMAGE_BYTES
    int "Maximum accepted OTA application image size"
    range 65536 2097152
    default 2097152

endmenu
```

## firmware/sdkconfig.defaults
```kconfig
CONFIG_IDF_TARGET="esp32s3"
CONFIG_ESPTOOLPY_FLASHSIZE_8MB=y
CONFIG_ESPTOOLPY_FLASHSIZE="8MB"

# ESP32-S3-PICO-1-N8R8 has 8 MB of in-package octal PSRAM.
CONFIG_SPIRAM=y
CONFIG_SPIRAM_MODE_OCT=y
CONFIG_SPIRAM_SPEED_80M=y
CONFIG_SPIRAM_BOOT_INIT=y
CONFIG_SPIRAM_IGNORE_NOTFOUND=n
CONFIG_SPIRAM_USE_MALLOC=y
CONFIG_SPIRAM_MEMTEST=y
CONFIG_SPIRAM_MALLOC_ALWAYSINTERNAL=16384
CONFIG_SPIRAM_MALLOC_RESERVE_INTERNAL=32768

CONFIG_ESP_CONSOLE_USB_SERIAL_JTAG=y
CONFIG_ESP_CONSOLE_SECONDARY_NONE=y
CONFIG_ESP_CONSOLE_UART_DEFAULT=n
CONFIG_ESP_CONSOLE_UART=n
CONFIG_ESP_MAIN_TASK_STACK_SIZE=16384
CONFIG_BOOTLOADER_APP_ROLLBACK_ENABLE=y
CONFIG_PARTITION_TABLE_CUSTOM=y
CONFIG_PARTITION_TABLE_CUSTOM_FILENAME="partitions.csv"

# Keep signed images small enough to leave 384 KiB in every 2 MiB app slot.
# Assertions remain enabled; only the compiler's optimization goal changes.
CONFIG_COMPILER_OPTIMIZATION_SIZE=y
CONFIG_COMPILER_OPTIMIZATION_ASSERTIONS_ENABLE=y
CONFIG_PJ_OTA_MAX_IMAGE_BYTES=1703936

# Pocket Journal does not use ESP-IDF's public Web PKI trust bundle. Companion
# sync is authenticated on the local network and OTA images have two separate
# signature checks, so retaining the indirectly linked bundle wastes 163 KiB.
CONFIG_MBEDTLS_CERTIFICATE_BUNDLE=n

# Provisioning supplies SSID/password credentials for station mode. There is no
# SoftAP or 802.1X credential surface in the device, partner CLI, or HTTP API.
CONFIG_ESP_WIFI_SOFTAP_SUPPORT=n
CONFIG_ESP_WIFI_ENTERPRISE_SUPPORT=n

CONFIG_BT_ENABLED=y
CONFIG_BT_NIMBLE_ENABLED=y
CONFIG_BT_BLUEDROID_ENABLED=n
CONFIG_BT_NIMBLE_ROLE_CENTRAL=n
CONFIG_BT_NIMBLE_ROLE_PERIPHERAL=y
CONFIG_BT_NIMBLE_ROLE_BROADCASTER=n
CONFIG_BT_NIMBLE_ROLE_OBSERVER=n
CONFIG_BT_NIMBLE_GATT_SERVER=y
CONFIG_BT_NIMBLE_GAP_SERVICE=y
CONFIG_BT_NIMBLE_SM_LEGACY=y
CONFIG_BT_NIMBLE_SM_SC=y
CONFIG_BT_NIMBLE_SM_LVL=0
CONFIG_BT_NIMBLE_SM_SC_ONLY=0
CONFIG_BT_NIMBLE_PROX_SERVICE=n
CONFIG_BT_NIMBLE_ANS_SERVICE=n
CONFIG_BT_NIMBLE_CTS_SERVICE=n
CONFIG_BT_NIMBLE_HTP_SERVICE=n
CONFIG_BT_NIMBLE_IPSS_SERVICE=n
CONFIG_BT_NIMBLE_TPS_SERVICE=n
CONFIG_BT_NIMBLE_IAS_SERVICE=n
CONFIG_BT_NIMBLE_LLS_SERVICE=n
CONFIG_BT_NIMBLE_SPS_SERVICE=n
CONFIG_BT_NIMBLE_HR_SERVICE=n
CONFIG_BT_NIMBLE_BAS_SERVICE=n
CONFIG_BT_NIMBLE_DIS_SERVICE=n
```
